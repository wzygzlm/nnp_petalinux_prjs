## custom_nnp_2018_2/project-spec/meta-user/conf/layer.conf
```bitbake
# We have a conf and classes directory, add to BBPATH
BBPATH .= ":${LAYERDIR}"

# We have recipes-* directories, add to BBFILES
BBFILES += "${LAYERDIR}/recipes-*/*/*.bb \
	${LAYERDIR}/recipes-*/*/*.bbappend"

BBFILE_COLLECTIONS += "meta-user"
BBFILE_PATTERN_meta-user = "^${LAYERDIR}/"
BBFILE_PRIORITY_meta-user = "8"

DISTRO_FEATURES_append = " wifi bluetooth bluez5 dbus pulseaudio"

LICENSE_FLAGS_WHITELIST_append = " commercial"

# These are user-specific scripts and files
IMAGE_INSTALL_append +=" custom"
```
